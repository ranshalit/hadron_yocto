## sources/meta-hadron/conf/layer.conf
```bitbake
BBPATH .= ":${LAYERDIR}"

BBFILES += "${LAYERDIR}/recipes-*/*/*.bb \
            ${LAYERDIR}/recipes-*/*/*.bbappend"

BBFILE_COLLECTIONS += "meta-hadron"
BBFILE_PATTERN_meta-hadron = "^${LAYERDIR}/"
BBFILE_PRIORITY_meta-hadron = "10"

LAYERSERIES_COMPAT_meta-hadron = "scarthgap"
LAYERDEPENDS_meta-hadron = "core tegra"
```

## sources/meta-hadron/conf/machine/hadron-ngx012.conf
```bitbake
#@TYPE: Machine
#@NAME: ConnectTech Hadron NGX012 (Jetson Orin Nano 4GB)
#@DESCRIPTION: ConnectTech Hadron carrier board with Jetson Orin Nano 4GB (p3767-0003)

require conf/machine/p3768-0000-p3767-0003.conf

PACKAGECONFIG:append:pn-systemd = " networkd"

# Use CTI precompiled board DTB instead of NVIDIA devkit DTB.
# cti-board-support provides virtual/dtb and installs this to /boot/devicetree/ in sysroot,
# which image_types_tegra.bbclass picks up via EXTERNAL_KERNEL_DEVICETREE.
KERNEL_DEVICETREE = "tegra234-orin-nano-cti-NGX012.dtb"
PREFERRED_PROVIDER_virtual/dtb = "cti-board-support"

# CTI Hadron carrier pinmux replaces the NVIDIA devkit pinmux for BCT generation.
# The file is installed to ${datadir}/tegraflash/ by cti-board-support and picked up
# by tegraflash_populate_package via its tegra234-*.dts* glob.
TEGRA_FLASHVAR_PINMUX_CONFIG   = "tegra234-cti-orin-nx-hadron-mb1-bct-pinmux.dtsi"

# CTI MB2-BCT: sets cvb_eeprom_read_size=0 so MB2 does not try to read the
# carrier board EEPROM (not present on the Hadron carrier) — without this the
# board hangs with "eeprom: Failed to read I2C slave device" before UEFI starts.
TEGRA_FLASHVAR_MB2BCT_CFG      = "tegra234-cti-orin-nx-mb2-bct-misc.dts"

# CTI GPIO-interrupt and SCR (Security Configuration Register) BCT overrides.
TEGRA_FLASHVAR_GPIOINT_CONFIG  = "tegra234-cti-orin-nx-mb1-bct-gpioint.dts"
TEGRA_FLASHVAR_SCR_CONFIG      = "tegra234-cti-orin-nx-mb2-bct-scr.dts"

# CTI module SKU overlay (0003 = Orin Nano 4GB) provides OPP tables for the correct
# memory/CPU variant. Replaces NVIDIA devkit dynamic overlay — the full CTI board DTB
# already covers carrier-specific configuration, so no devkit dynamic overlay is needed.
TEGRA_PLUGIN_MANAGER_OVERLAYS = "tegra234-cti-orin-nano-0003-nv-super-overlay.dtbo"
```
